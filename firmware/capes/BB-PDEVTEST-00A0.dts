/*
 * Copyright (C) 2013 Pantelis Antoniou <panto@antoniou-consulting.com>
 *
 * This program is free software; you can redistribute it and/or modify
 * it under the terms of the GNU General Public License version 2 as
 * published by the Free Software Foundation.
 */
/dts-v1/;
/plugin/;

/ {
	compatible = "ti,beaglebone", "ti,beaglebone-black";

	/* identification */
	part-number = "BB-PDEVTEST";
	version = "00A0";

	fragment@0 {
		target = <&ocp>;

		__overlay__ {
			pdevtest {
				compatible = "pdevtest";
				status = "okay";
			};
		};
	};
};
